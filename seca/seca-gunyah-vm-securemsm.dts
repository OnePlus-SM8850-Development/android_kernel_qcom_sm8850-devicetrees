// SPDX-License-Identifier: BSD-3-Clause
/*
 * Copyright (c) Qualcomm Technologies, Inc. and/or its subsidiaries.
 */

/dts-v1/;
/plugin/;

#include "seca-vm-securemsm.dtsi"

/ {
	model = "Qualcomm Technologies, Inc. SA8787p Gunyah LA VM";
	compatible = "qcom,sa8787p", "qcom,qam";
	qcom,msm-id = <742 0x10000>, <742 0x10001>;
	qcom,board-id = <0x00010019 0x0>;
};
