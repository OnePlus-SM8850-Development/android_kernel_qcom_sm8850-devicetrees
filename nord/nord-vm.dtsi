// SPDX-License-Identifier: BSD-3-Clause
/*
 * Copyright (c) Qualcomm Technologies, Inc. and/or its subsidiaries.
 */

&firmware {
	qcom_smcinvoke {
		compatible = "qcom,smcinvoke";
		/*To disable ADCI thread*/
		qcom,disable-adci;
	};
};
