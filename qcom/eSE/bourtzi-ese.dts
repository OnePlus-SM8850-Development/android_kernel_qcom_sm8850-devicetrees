// SPDX-License-Identifier: BSD-3-Clause
/*
 * Copyright (c) Qualcomm Technologies, Inc. and/or its subsidiaries.
 */

/dts-v1/;
/plugin/;

&soc {
	st54spi_gpio {
		status = "okay";
		compatible = "st,st54spi_gpio";
		/* gpio used as SE_nRESET/NFC_en */
		gpio-power_nreset = <&tlmm 31 0x00>;
	};
};

/ {
	model = "Qualcomm Technologies, Inc. Bourtzi SoC";
	compatible = "qcom,bourtzi";
	qcom,board-id = <0x10021 0x0>, <0x10001 0x0>, <0x20001 0x0>, <0x10008 0x600>,
			<0x10008 0x0>, <0x20008 0x0>, <0x1000B 0x0>, <0x2000B 0x0>,
			<0x10015 0x0>, <0x20015 0x0>, <0x30015 0x0>, <0x40015 0x0>;
	qcom,msm-id = <777 0x10000>, <776 0x10000>;
};
