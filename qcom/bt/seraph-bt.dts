/*
 * Copyright (c) Qualcomm Technologies, Inc. and/or its subsidiaries.
 * SPDX-License-Identifier: BSD-3-Clause-Clear
 */

/dts-v1/;
/plugin/;

#include "seraph-bt.dtsi"

/ {
        model = "Qualcomm Technologies, Inc. Seraph SoC";
        compatible = "qcom,seraph";
        qcom,msm-id = <672 0x10000>, <673 0x10000>;
        qcom,board-id = <0x10021 0>, <0x10022 0>, <0x10022 1>, <0x10022 2>, <0x10022 3>;
};

